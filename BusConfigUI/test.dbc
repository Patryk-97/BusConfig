VERSION ""

NS_ :

BS_:

BU_: New_Node_2 New_Node_1
VAL_TABLE_ New_Value_Table_1 15 "Description for the value
 '0xF'" 14 "Description for the value '0xE'" 13 "Description for the value '0xD'" 12 "Description for the value '0xC'" 11 "Description for the value '0xB'" 10 "Description for the value '0xA'" 9 "Description for the value '0x9'" 8 "Description for the value '0x8'" 7 "Description for the value '0x7'" 6 "Description for the value '0x6'" 5 "Description for the value '0x5'" 4 "Description for the value '0x4'" 3 "Description for the value '0x3'" 2 "Description for the value '0x2'" 1 "Description for the value '0x1'" 0 "Description for the value '0x0'" ;

BO_ 0 New_Message_1: 12 New_Node_1
 SG_ New_Signal_2 : 64|8@1+ (1,0) [0|0] "" Vector__XXX
 SG_ New_Signal_1 : 0|64@1- (1,0) [-1.7E+308|1.7E+308] ""  New_Node_2

EV_ New_Variable_3: 0 [0|0] "" 0 1 DUMMY_NODE_VECTOR3 Vector__XXX;

EV_ New_Variable_2: 0 [0|0] "" 892625477 2 DUMMY_NODE_VECTOR0  New_Node_1;

EV_ New_Variable_1: 0 [0|0] "test" 0 3 DUMMY_NODE_VECTOR8001 Vector__XXX;
ENVVAR_DATA_ New_Variable_3: 100;

CM_ SG_ 0 New_Signal_1 "THIS
is
A
signal";
CM_ EV_ New_Variable_1 "THIS
is
A
variable";
BA_DEF_  "BaudrateCANFD" INT 0 0;
BA_DEF_  "Baudrate" INT 0 0;
BA_DEF_ BO_  "CANFD_BRS" ENUM  "0","1";
BA_DEF_  "DBName" STRING ;
BA_DEF_  "BusType" STRING ;
BA_DEF_ BO_  "VFrameFormat" ENUM  "StandardCAN","ExtendedCAN","reserved","reserved","reserved","reserved","reserved","reserved","reserved","reserved","reserved","reserved","reserved","reserved","StandardCAN_FD","ExtendedCAN_FD";
BA_DEF_DEF_  "BaudrateCANFD" 1000000;
BA_DEF_DEF_  "Baudrate" 500000;
BA_DEF_DEF_  "CANFD_BRS" "1";
BA_DEF_DEF_  "DBName" "";
BA_DEF_DEF_  "BusType" "";
BA_DEF_DEF_  "VFrameFormat" "StandardCAN";
BA_ "BaudrateCANFD" 1200000;
BA_ "Baudrate" 600000;
BA_ "BusType" "CAN FD";
BA_ "DBName" "test";
BA_ "VFrameFormat" BO_ 0 14;
VAL_ New_Variable_2 15 "Description for the value '0xF'" 14 "Description for the value '0xE'" 13 "Description for the value '0xD'" 12 "Description for the value '0xC'" 11 "Description for the value '0xB'" 10 "Description for the value '0xA'" 9 "Description for the value '0x9'" 8 "Description for the value '0x8'" 7 "Description for the value '0x7'" 6 "Description for the value '0x6'" 5 "Description for the value '0x5'" 4 "Description for the value '0x4'" 3 "Description for the value '0x3'" 2 "Description for the value '0x2'" 1 "Description for the value '0x1'" 0 "Description for the value '0x0'" ;
SIG_VALTYPE_ 0 New_Signal_1 : 2;
